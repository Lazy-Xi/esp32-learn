## components/web_server/Kconfig
```kconfig
menu "Web Server Configuration"

    config WEB_SERVER_PORT
        int "HTTP Server Port"
        range 1 65535
        default 80

    config WEB_SERVER_MAX_CONNECTIONS
        int "Maximum Connections"
        range 1 16
        default 7

    config WEB_SERVER_MAX_REQUEST_SIZE
        int "Maximum Request Body Size"
        range 128 4096
        default 1024

endmenu
```

## main/Kconfig.projbuild
```kconfig
menu "Chemecar Configuration"

    menu "WiFi Configuration"

        config WIFI_SSID
            string "WiFi SSID"
            default "Your-WiFi"
            help
                WiFi network SSID.

        config WIFI_PASSWORD
            string "WiFi Password"
            default "Your-Password"
            help
                WiFi WPA2 password. Must be 8-63 bytes.

    endmenu

    menu "Relay Configuration"

        config RELAY_COUNT
            int "Number of Relays"
            range 1 4

        config RELAY_GPIO_0
            int "Relay 0 GPIO"
            range 0 27

        config RELAY_GPIO_1
            int "Relay 1 GPIO"
            range 0 27

        config RELAY_GPIO_2
            int "Relay 2 GPIO"
            range 0 27

        config RELAY_GPIO_3
            int "Relay 3 GPIO"
            range 0 27

        config RELAY_ACTIVE_LOW
            bool "Relay Active Low"
            default y

    endmenu

    menu "Web Server Configuration"

        config WEB_SERVER_ENABLED
            bool "Enable Web Server"
            default y

    endmenu

endmenu
```
